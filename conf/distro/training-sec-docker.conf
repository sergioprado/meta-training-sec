## conf/distro/training-sec-docker.conf
```bitbake
require training-sec.conf

DISTRO_NAME = "Embedded Security Training (docker)"

DISTROOVERRIDES:append = ":docker"

DISTRO_FEATURES:append = "\
    virtualization \
    seccomp \
"
```

## conf/distro/training-sec-selinux.conf
```bitbake
require training-sec.conf

DISTRO_NAME = "Embedded Security Training (selinux)"

DISTROOVERRIDES:append = ":selinux"

DISTRO_FEATURES:append = "\
    selinux \
"

PREFERRED_PROVIDER_virtual/refpolicy ?= "refpolicy-targeted"

PREFERRED_PROVIDER_coreutils = "coreutils"

BBMASK += "\
    /meta-oe/recipes-core/uutils-coreutils/ \
"
```

## conf/distro/training-sec-signed.conf
```bitbake
require training-sec.conf

DISTRO_NAME = "Embedded Security Training (signed)"

DISTROOVERRIDES:append = ":signed"

# FIT image signing
UBOOT_SIGN_ENABLE = "1"
UBOOT_SIGN_KEYDIR = "${TOPDIR}/keys/fit"
UBOOT_SIGN_KEYNAME = "dev"
FIT_GENERATE_KEYS = "1"
FIT_SIGN_INDIVIDUAL = "0"
UBOOT_MKIMAGE_DTCOPTS = "-I dts -O dtb -p 2000"

# rootfs image that will be used to create dmverity image
# override it when building a different image
DM_VERITY_IMAGE ?= "training-sec-image"
DM_VERITY_IMAGE_TYPE ?= "ext4"

# enable creation of dmverity image
IMAGE_CLASSES += "dm-verity-img"
WICVARS:append = "\
    DM_VERITY_IMAGE \
    DM_VERITY_IMAGE_TYPE \
"

# mount the rootfs image only from a dmverity image
BAD_RECOMMENDATIONS += "initramfs-module-rootfs"
```

## conf/distro/training-sec.conf
```bitbake
DISTRO_NAME = "Embedded Security Training"
DISTRO_VERSION = "1.0.0"

TARGET_VENDOR = "-trsec"

MAINTAINER = "Sergio Prado <sergio.prado@e-labworks.com>"

TCMODE = "default"
TCLIBC = "glibc"

PACKAGE_CLASSES ?= "package_ipk"

SDK_VENDOR = "-trsecsdk"
SDK_VERSION = "${@d.getVar('DISTRO_VERSION').replace('snapshot-${METADATA_REVISION}', 'snapshot')}"
SDK_VERSION[vardepvalue] = "${SDK_VERSION}"
SDK_NAME = "${DISTRO}-${TCLIBC}-${SDKMACHINE}-${IMAGE_BASENAME}-${TUNE_PKGARCH}-${MACHINE}"
SDKPATHINSTALL = "/opt/labs/ex/sdk"

DISTRO_FEATURES = "\
    acl \
    xattr \
    pam \
    tpm2 \
    rauc \
"

INITRAMFS_IMAGE = "training-sec-image-ramdisk"
INITRAMFS_IMAGE_BUNDLE = "0"

KERNEL_CLASSES = "kernel-fitimage"
KERNEL_IMAGETYPES = "fitImage"

# rauc signing key/cert
RAUC_KEY_FILE = "${COREBASE}/../meta-training-sec/files/rauc/development-1.key.pem"
RAUC_CERT_FILE = "${COREBASE}/../meta-training-sec/files/rauc/development-1.cert.pem"
RAUC_KEYRING_FILE = "${COREBASE}/../meta-training-sec/files/rauc/ca.cert.pem"

# disable external layers sanity checks
SKIP_META_SECURITY_SANITY_CHECK = "1"
SKIP_META_VIRT_SANITY_CHECK = "1"

require conf/distro/include/security_flags.inc

# extend machine configuration if needed
include conf/machine/training-sec-${MACHINE}.conf
```

## conf/layer.conf
```bitbake
# We have a conf and classes directory, add to BBPATH
BBPATH .= ":${LAYERDIR}"

# We have recipes-* directories, add to BBFILES
BBFILES += "${LAYERDIR}/recipes-*/*/*.bb \
            ${LAYERDIR}/recipes-*/*/*.bbappend"

BBFILE_COLLECTIONS += "meta-training-sec"
BBFILE_PATTERN_meta-training-sec = "^${LAYERDIR}/"
BBFILE_PRIORITY_meta-training-sec = "50"

LAYERDEPENDS_meta-training-sec = "core"
LAYERSERIES_COMPAT_meta-training-sec = "scarthgap"
```

## conf/machine/training-sec-qemuarm64.conf
```bitbake
# OP-TEE configuration
MACHINEOVERRIDES =. "qemuarm64-secureboot:"
QEMU_USE_KVM = ""
QB_MACHINE = "-machine virt,secure=on"
QB_OPT_APPEND += "-no-acpi"
QB_MEM = "-m 1024"
QB_DEFAULT_BIOS = "flash.bin"
WKS_FILE_DEPENDS = "trusted-firmware-a e2fsprogs-native"
MACHINE_FEATURES:append = " optee-ftpm"

# U-Boot configuration
QB_OPT_APPEND += "-drive if=pflash,format=raw,index=1,file=${TMPDIR}/deploy/images/${MACHINE}/bootenv.img"
PREFERRED_PROVIDER_virtual/bootloader = "u-boot"
PREFERRED_RPROVIDER_u-boot-default-env = "libubootenv"
EXTRA_IMAGEDEPENDS += "u-boot"
UBOOT_ENV = "boot"
UBOOT_ENV_SUFFIX = "scr"

# kernel configuration
KERNEL_DEVICETREE += "arm/qemuarm64.dtb"

# FIT image load addresses
UBOOT_LOADADDRESS = "0x40400000"
UBOOT_ENTRYPOINT = "0x40400000"
UBOOT_DTB_LOADADDRESS = "0x40000000"
UBOOT_RD_LOADADDRESS = "0x44000000"

# WIC configuration
WKS_FILE = "training-sec-qemuarm64.wks"
WKS_FILE:signed = "training-sec-signed-qemuarm64.wks"
IMAGE_FSTYPES = "tar.bz2 wic"
QB_DEFAULT_FSTYPE = "wic"
QB_DRIVE_TYPE = "/dev/vdb"
IMAGE_BOOT_FILES = "\
    fitImage-${INITRAMFS_IMAGE}-${MACHINE}-${MACHINE};fitImage \
"
```

## wic/training-sec-qemuarm64.wks
```
bootloader --ptable gpt
part /boot --source bootimg-partition --ondisk sda --fstype=ext4 --use-uuid --label boot --active --align 1024
part / --source rootfs --ondisk sda --fstype=ext4 --label rootfs_a --align 4 --use-uuid
part / --source rootfs --ondisk sda --fstype=ext4 --label rootfs_b --align 4 --use-uuid --fsoptions "defaults,noauto"
part /apps   --ondisk sda --fstype=ext4 --label apps   --fixed-size 32M --use-uuid --fsoptions "defaults,noauto" --mkfs-extraopts="-O verity -b 4096"
part /config --ondisk sda --fstype=ext4 --label config --fixed-size 32M --use-uuid --fsoptions "defaults,noauto"
part /data   --ondisk sda --fstype=ext4 --label data   --fixed-size 64M --use-uuid --fsoptions "defaults,noauto"
```

## wic/training-sec-signed-qemuarm64.wks
```
bootloader --ptable gpt
part /boot --source bootimg-partition --ondisk sda --fstype=ext4 --use-uuid --label boot --active --align 1024
part / --source rawcopy --ondisk sda --sourceparams="file=${IMGDEPLOYDIR}/${DM_VERITY_IMAGE}-${MACHINE}.rootfs.${DM_VERITY_IMAGE_TYPE}.verity"
part / --source rawcopy --ondisk sda --sourceparams="file=${IMGDEPLOYDIR}/${DM_VERITY_IMAGE}-${MACHINE}.rootfs.${DM_VERITY_IMAGE_TYPE}.verity"
part /apps   --ondisk sda --fstype=ext4 --label apps   --fixed-size 32M --use-uuid --fsoptions "defaults,noauto" --mkfs-extraopts="-O verity -b 4096"
part /config --ondisk sda --fstype=ext4 --label config --fixed-size 32M --use-uuid --fsoptions "defaults,noauto"
part /data   --ondisk sda --fstype=ext4 --label data   --fixed-size 64M --use-uuid --fsoptions "defaults,noauto"
```
